## main/Kconfig.projbuild
```kconfig
menu "Example Configuration"

    choice ESPNOW_WIFI_MODE
        prompt "WiFi mode"
        default ESPNOW_WIFI_MODE_STATION
        help
            WiFi mode(station or softap).

        config ESPNOW_WIFI_MODE_STATION
            bool "Station"
        config ESPNOW_WIFI_MODE_STATION_SOFTAP
            bool "Softap"
    endchoice

    config ESPNOW_CHANNEL
        int "Channel"
        default 1
        range 0 14
        help
            The channel on which sending and receiving ESPNOW data.

    config NEIGHBOR_DETECTION_DURATION
        int "Neighbor Detection Duration"
        default 1000
        range 500 10000
        help
            Duration in which broadcast gets send around the WSN in ms.

    config TIMESTAMP_SEND_DELAY
        int "Timestamp Send Interval"
        default 50
        range 10 100
        help
            Delay between timestamp broadcasts in ms during neighbor detection phase.
    
    config NATIVE_SEND_DELAY
        int "Native packet send interval"
        default 100
        range 50 1000
        help
            Delay between sending native packets in ms during message exchange phase.
    
    config DEEPSLEEP_DURATION_MS
        int "Deep Sleep Duration"
        range 50 3600000
        default 500
        help
            Duration each device stays in deepsleep, unit in milliseconds.

    config MSG_EXCHANGE_DURATION_MS
        int "Message Exchange Duration"
        range 1000 3600000
        default 10000
        help
            Duration of the message exchange phase, unit in milliseconds.
        
endmenu
```
